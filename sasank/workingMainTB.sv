module tb();
    reg fastClk, slowClk, rst;
    reg [12:0] serialData;
    wire [2:0] out;
    reg writeEn;
    logic [12:0] segment [1428] = '{13'b0001011011100, 13'b0001001100011, 13'b0001010010001, 13'b0001001111011, 13'b0001010010000, 13'b0001010000001, 13'b0001010010000, 13'b0001010001100, 13'b0001010011110, 13'b0001010011110, 13'b0001010110100, 13'b0001010111100, 13'b0001011001001,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 13'b0001101111000, 13'b0001110101001};
    

    // Instantiate the top module
    top myTop(
        .slowClk(slowClk),
        .fastClk(fastClk),
        .rst(rst),
        .serialData(serialData),
        .dout(out),
        .write_enable(writeEn)
    );

    // Generate slow clock (e.g., 10ns period)
    initial begin
        slowClk = 0;
        forever #1 slowClk = ~slowClk; // 10ns clock period
    end

    // Generate fast clock (e.g., 1ns period)
    

    integer i;
    initial begin
        fastClk = 0;
        rst = 1;
        serialData = 13'b0; // Initialize serialData
        writeEn = 0;
        #20 rst = 0; // Release reset after 20ns

        // Write first 300 samples to the queue
        writeEn = 1;
        for (i = 0; i < 300; i = i + 1) begin
            @(posedge slowClk); // Wait for the positive edge of the slow clock
            serialData = segment[i]; // Input the next data sample
        end

        // Disable queue writing
        writeEn = 0;

        // Run fast clock for 600 cycles
        for(i=0; i < 600; i = i+1) begin
            fastClk = ~fastClk; #1;
        end
        

        // Enable queue writing and write the next 300 samples
        writeEn = 1;
        for (i = 300; i < 600; i = i + 1) begin
            @(posedge slowClk); // Wait for the positive edge of the slow clock
            serialData = segment[i]; // Input the next data sample
        end

        // Disable queue writing
        writeEn = 0;

        // Run fast clock for 600 cycles
        

        // Enable queue writing and write the next 300 samples
        writeEn = 1;
        for (i = 600; i < 900; i = i + 1) begin
            @(posedge slowClk); // Wait for the positive edge of the slow clock
            serialData = segment[i]; // Input the next data sample
        end

        // Disable queue writing
        writeEn = 0;

        // Run fast clock for 600 cycles
        for(i=0; i < 600; i = i+1) begin
            fastClk = ~fastClk; #1;
        end

        // Enable queue writing and write the next 300 samples
        writeEn = 1;
        for (i = 900; i < 1200; i = i + 1) begin
            @(posedge slowClk); // Wait for the positive edge of the slow clock
            serialData = segment[i]; // Input the next data sample
        end

        // Disable queue writing
        writeEn = 0;

        // Run fast clock for 600 cycles
        for(i=0; i < 600; i = i+1) begin
            fastClk = ~fastClk; #1;
        end

        // Enable queue writing and write the remaining samples
        writeEn = 1;
        for (i = 1200; i < 1428; i = i + 1) begin
            @(posedge slowClk); // Wait for the positive edge of the slow clock
            serialData = segment[i]; // Input the next data sample
        end

        // Finish simulation
        #10 $finish;
    end

endmodule
